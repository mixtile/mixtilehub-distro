## meta-mixtilehub/conf/distro/mixtilehub.conf
```bitbake
DISTRO = "mixtilehub"

PACKAGE_CLASSES = "package_ipk"

DISTRO_NAME = "mixtilehub"

DISTRO_FEATURES_append = " ext2 alsa systemd"

DISTRO_FEATURES_append_mixtilehub = " x11 opengl"

VIRTUAL-RUNTIME_init_manager = "systemd"
DISTRO_FEATURES_BACKFILL_CONSIDERED = "sysvinit"
VIRTUAL-RUNTIME_initscripts = ""
```

## meta-mixtilehub/conf/layer.conf
```bitbake
# We have a conf and classes directory, append to BBPATH
BBPATH .= ":${LAYERDIR}"

# We have a recipes directory, add to BBFILES
BBFILES += "${LAYERDIR}/recipes*/*/*.bb ${LAYERDIR}/recipes*/*/*.bbappend"

# Machine-specific 'layer'
BBFILES += "${LAYERDIR}/${MACHINE}/recipes*/*/*.bb ${LAYERDIR}/${MACHINE}/recipes*/*/*.bbappend"

BBFILE_COLLECTIONS += "meta-mixtilehub"
BBFILE_PATTERN_meta-mixtilehub := "^${LAYERDIR}/"
BBFILE_PRIORITY_meta-mixtilehub = "10"

LAYERSERIES_COMPAT_meta-mixtilehub = "sumo thud"
```

## meta-mixtilehub/conf/machine/include/sun8i.inc
```bitbake
require conf/machine/include/tune-cortexa7.inc

SOC_FAMILY ??= ""
include conf/machine/include/soc-family.inc

# Sub-architecture support
MACHINE_SOCARCH_SUFFIX ?= ""

PREFERRED_PROVIDER_virtual/xserver = "xserver-xorg"
XSERVER = "xserver-xorg \
           xserver-xorg-module-exa \ 
           xf86-video-armsoc \
	   xf86-input-evdev \
           xf86-input-mouse \
           xf86-input-keyboard"

PREFERRED_PROVIDER_virtual/kernel = "linux-mixtilehub"
PREFERRED_PROVIDER_u-boot = "u-boot-mixtilehub"
PREFERRED_PROVIDER_virtual/bootloader = "u-boot-mixtilehub"

KERNEL_IMAGETYPE ?= "uImage"

IMAGE_FSTYPES += "ext4 tar.gz"

MACHINE_EXTRA_RRECOMMENDS = "kernel-modules"

UBOOT_LOCALVERSION = "-g${@d.getVar('SRCPV', True).partition('+')[2][0:7]}"

UBOOT_ENTRYPOINT ?= "0x40008000"
UBOOT_LOADADDRESS ?= "0x400080OB00"

SERIAL_CONSOLE ?= "115200 ttyS0"
MACHINE_FEATURES ?= "alsa apm keyboard rtc serial screen usbgadget usbhost vfat"

SOC_FAMILY = "sun8i"
```

## meta-mixtilehub/conf/machine/mixtilehub.conf
```bitbake
#@TYPE: Machine
#@NAME: mixtilehub
#@DESCRIPTION: Machine configuration for the mixtilehub, base on allwinner H3 CPU

require conf/machine/include/sun8i.inc

MACHINE_FEATURES += "ext2 vfat"

KERNEL_DEVICETREE = "sun8i-h3-mixtilehub.dtb"
UBOOT_MACHINE = "mixtilehub_defconfig"

DEFAULTTUNE = "cortexa7hf-neon-vfpv4"

PREFERRED_VERSION_linux-mixtilehub = "5.0"
```
